## drivers/firmware/coreboot/Kconfig
```kconfig
menuconfig COREBOOT_TABLES
	bool "Coreboot tables"
	default n
	help
	  These drivers are used to export coreboot tables to sysfs

if COREBOOT_TABLES

config COREBOOT_SYSFS
	tristate "Coreboot sysfs driver"
	default n
	help
	  This driver create coreboot node in /sys/firmware

config COREBOOT_MEMORY
	tristate "Coreboot nemory table table"
	default n
	depends on COREBOOT_SYSFS && GOOGLE_COREBOOT_TABLE
	help
		This driver creates coreboot node /sys/firmware/coreboot/memory

endif # COREBOOT_TABLES
```
